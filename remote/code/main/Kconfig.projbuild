## remote/code/main/Kconfig.projbuild
```kconfig
menu "StackChan remote controller"

choice STACKCHAN_TARGET_BOARD
    prompt "Target board"
    default STACKCHAN_TARGET_M5STICK_S3 if IDF_TARGET_ESP32S3
    default STACKCHAN_TARGET_M5STICK_C_PLUS if IDF_TARGET_ESP32
    help
        Select the board profile used by the remote controller firmware.

    config STACKCHAN_TARGET_M5STICK_C_PLUS
        bool "M5StickC Plus"
    config STACKCHAN_TARGET_M5STICK_S3
        bool "M5StickS3"
endchoice

choice STACKCHAN_JOYSTICK_PORT
    prompt "Joystick connection"
    default STACKCHAN_JOYSTICK_PORT_GROVE if STACKCHAN_TARGET_M5STICK_S3
    default STACKCHAN_JOYSTICK_PORT_LEGACY_STICKC_HAT if STACKCHAN_TARGET_M5STICK_C_PLUS
    help
        Select the physical port used by the I2C joystick.
        M5StickS3 is structurally incompatible with the Hat Mini JoyC (SKU U156)
        according to the StickS3 product notes; use a Grove joystick unit or a
        known-good adapter wiring instead of direct HAT attachment.

    config STACKCHAN_JOYSTICK_PORT_LEGACY_STICKC_HAT
        bool "StickC Plus HAT / legacy wiring (SDA=GPIO0, SCL=GPIO26)"
    config STACKCHAN_JOYSTICK_PORT_MINIJOYC_HAT
        bool "Experimental MiniJoyC HAT wiring (SDA=GPIO2, SCL=GPIO1)"
    config STACKCHAN_JOYSTICK_PORT_GROVE
        bool "Grove / M5Unified Ex_I2C"
endchoice

endmenu
```
